## firmware/main/Kconfig.projbuild
```kconfig
menu "CO2 sensor"

    config WIFI_SSID
        string "Wi-Fi SSID"
        default ""

    config WIFI_PASSWORD
        string "Wi-Fi password"
        default ""

    config MQTT_URI
        string "MQTT broker URI"
        default "mqtts://xxxx.s1.eu.hivemq.cloud:8883"

    config MQTT_USERNAME
        string "MQTT username"
        default ""

    config MQTT_PASSWORD
        string "MQTT password"
        default ""

endmenu
```

## main/Kconfig.projbuild
```kconfig
menu "CO2 sensor"

    config WIFI_SSID
        string "Wi-Fi SSID"
        default ""

    config WIFI_PASSWORD
        string "Wi-Fi password"
        default ""

endmenu
```
